## conf/distro/llddist.conf
```bitbake
require conf/distro/poky.conf      
# distro name  
DISTRO = "llddist"      
DISTRO_NAME = "Linh Linux Distribution"      
DISTRO_VERSION = "1.0"      
DISTRO_CODENAME = "lld"      
DISTRO_FEATURES_append = " "
SDK_VENDOR = "-llddistsdk"      
SDK_VERSION := "${@'${DISTRO_VERSION}'.replace('snapshot-${DATE}','snapshot')}"      
MAINTAINER = "llddist "      
INHERIT += "buildhistory"      
BUILDHISTORY_COMMIT = "1" 
```

## conf/layer.conf
```bitbake
BBPATH .= ":${LAYERDIR}"    
BBFILES += "${LAYERDIR}/recipes-*/*/*.bb \   
    ${LAYERDIR}/recipes-*/*/*.bbappend"    
BBFILE_COLLECTIONS += "lld"    
BBFILE_PATTERN_lld = "^${LAYERDIR}/"    
BBFILE_PRIORITY_lld = "6"   
```
